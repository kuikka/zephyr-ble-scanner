## CMakeLists.txt
```
# SPDX-License-Identifier: Apache-2.0

#set(BOARD nrf52840dongle_nrf52840)   # Dongle
set(BOARD nrf52840dk_nrf52840)   # DK

set(CMAKE_EXPORT_COMPILE_COMMANDS ON CACHE INTERNAL "")

cmake_minimum_required(VERSION 3.13.1)
find_package(Zephyr REQUIRED HINTS $ENV{ZEPHYR_BASE})
project(zephyr-ble-scanner)

FILE(GLOB app_sources src/*.c)
target_sources(app PRIVATE ${app_sources})
```

## prj.conf
```kconfig
CONFIG_PRINTK=y
CONFIG_LOG=y

CONFIG_BT=y
CONFIG_BT_CENTRAL=y
CONFIG_BT_GATT_CLIENT=y

CONFIG_LOG_BUFFER_SIZE=8192

CONFIG_USB_DEVICE_STACK=y
CONFIG_USB_DEVICE_PRODUCT="BLE scanner"
# CONFIG_USB_COMPOSITE_DEVICE=y
CONFIG_USB_CDC_ACM_RINGBUF_SIZE=512
CONFIG_USB_CDC_ACM=y
CONFIG_USB_DEVICE_INITIALIZE_AT_BOOT=n
CONFIG_SERIAL=y
CONFIG_UART_INTERRUPT_DRIVEN=y
CONFIG_UART_LINE_CTRL=y
```

## app.overlay
```dts
/*
 * Copyright (c) 2021 Nordic Semiconductor ASA
 *
 * SPDX-License-Identifier: Apache-2.0
 */

&zephyr_udc0 {
	cdc_acm_uart0 {
		compatible = "zephyr,cdc-acm-uart";
	};

/*
	cdc_acm_uart1 {
		compatible = "zephyr,cdc-acm-uart";
	};
	*/
};
```

## src/main.c
```c
/* main.c - Application main entry point */

/*
 * Copyright (c) 2015-2016 Intel Corporation
 *
 * SPDX-License-Identifier: Apache-2.0
 */

/* Based on scan_adv and cdc_acm samples in Zephyr */

#include <zephyr/types.h>
#include <stddef.h>
#include <string.h>
#include <zephyr/sys/printk.h>
#include <zephyr/sys/util.h>

#include <zephyr/bluetooth/bluetooth.h>
#include <zephyr/bluetooth/hci.h>
#include <zephyr/bluetooth/conn.h>
#include <zephyr/bluetooth/uuid.h>
#include <zephyr/bluetooth/gatt.h>
#include <zephyr/sys/byteorder.h>

#include <zephyr/usb/usb_device.h>
#include <zephyr/sys/ring_buffer.h>
#include <zephyr/drivers/uart.h>
#include <zephyr/logging/log.h>

#include <stdio.h>

#include "sensor_conn.h"
#include "sensor_scan.h"

#define MY_STACK_SIZE 500
#define MY_PRIORITY 5

static void ble_connecting_thread(void *, void *, void *);
static void uart_rx_thread(void *, void *, void *);

enum BleCommand
{
	BLE_CMD_CONNECT,
};

struct ble_data
{
	enum BleCommand cmd;
	bt_addr_le_t addr;
};

LOG_MODULE_REGISTER(ble_scanner, LOG_LEVEL_INF);

RING_BUF_ITEM_DECLARE_POW2(uart_tx_ringbuf, 10);
K_MUTEX_DEFINE(uart_tx_ringbuf_mutex);

RING_BUF_ITEM_DECLARE_POW2(uart_rx_ringbuf, 10);
struct k_sem uart_rx_ringbuffer_semaphore;

K_MEM_SLAB_DEFINE(ble_data_slab, sizeof(struct ble_data), 64, 4);
K_FIFO_DEFINE(ble_data_fifo);

K_THREAD_DEFINE(uart_rx_thread_tid, MY_STACK_SIZE,
                uart_rx_thread, NULL, NULL, NULL,
                MY_PRIORITY, 0, 0);

static const struct device *usb_uart;

static void interrupt_handler(const struct device *dev, void* data)
{
	while (uart_irq_update(dev) && uart_irq_is_pending(dev)) {
		if (uart_irq_rx_ready(dev)) {
			uint8_t buffer[64];

			int bytes_read = uart_fifo_read(dev, buffer, sizeof(buffer));

			ring_buf_put(&uart_rx_ringbuf, buffer, bytes_read);
			k_sem_give(&uart_rx_ringbuffer_semaphore);
		}

		if (uart_irq_tx_ready(dev)) {
			uint8_t buffer[64];
			int rb_len, send_len;

			rb_len = ring_buf_get(&uart_tx_ringbuf, buffer, sizeof(buffer));
			if (!rb_len) {
				LOG_DBG("Ring buffer empty, disable TX IRQ");
				uart_irq_tx_disable(dev);
				continue;
			}

			send_len = uart_fifo_fill(dev, buffer, rb_len);
			if (send_len < rb_len) {
				LOG_ERR("Drop %d bytes", rb_len - send_len);
			}
		}
	}
}

K_THREAD_DEFINE(ble_connecting_thread_tid, MY_STACK_SIZE,
                ble_connecting_thread, NULL, NULL, NULL,
                MY_PRIORITY, 0, 0);

void ble_connecting_thread(void *unused1, void *unused2, void *unused3)
{
	while(1)
	{
		struct ble_data *data;
		data = k_fifo_get(&ble_data_fifo, K_FOREVER);

	}
}

static void uart_rx_thread(void *unused1, void *unused2, void *unused3)
{
	k_sem_init(&uart_rx_ringbuffer_semaphore, 0, 1000);

	char cmd_buf[128];
	int cmd_buf_idx = 0;

	while(1)
	{
		if (k_sem_take(&uart_rx_ringbuffer_semaphore, K_FOREVER) == 0)
		{
			uint8_t buffer[65];
			memset(buffer, 0, sizeof(buffer));
			uint32_t bytes_read = ring_buf_get(&uart_rx_ringbuf, buffer, sizeof(buffer) - 1);

			int space_in_cmd_buf = sizeof(cmd_buf) - cmd_buf_idx;
			// Make space in command buffer
			if (space_in_cmd_buf < bytes_read)
			{
				const int bytes_to_shift = bytes_read - space_in_cmd_buf;
				memmove(&cmd_buf[0], &cmd_buf[bytes_to_shift], cmd_buf_idx - bytes_to_shift);
				cmd_buf_idx = cmd_buf_idx - bytes_to_shift;
			}

			space_in_cmd_buf = sizeof(cmd_buf) - cmd_buf_idx;
			const int bytes_to_copy = space_in_cmd_buf >= bytes_read ? bytes_read : space_in_cmd_buf;
			memcpy(&cmd_buf[cmd_buf_idx], buffer, bytes_to_copy);
			cmd_buf_idx += bytes_to_copy;

			cmd_buf[cmd_buf_idx] = 0;
			// printk("CMD_BUF: %s\n", cmd_buf);

			char *lf = strchr(cmd_buf, '\n');
			if (lf != NULL)
			{
				*lf = 0;

				char * comma = strchr(cmd_buf, ',');
				if (comma != NULL)
				{
					*comma = 0;
					char *cmd = cmd_buf;
					char *arg = comma + 1;
					printk("\nCMD: \"%s\", arg \"%s\"\n", cmd, arg);
					handle_command(cmd, arg);
					cmd_buf_idx = 0;
				}
			}
		}
	}
}

void write_tx(const char *s)
{
	const size_t length = strlen(s);
	k_mutex_lock(&uart_tx_ringbuf_mutex, K_FOREVER);
	ring_buf_put(&uart_tx_ringbuf, s, length);
	k_mutex_unlock(&uart_tx_ringbuf_mutex);

	uart_irq_tx_enable(usb_uart);
}

void main(void)
{
	int err;

	printk("Starting BLE scanner\n");

	usb_uart = DEVICE_DT_GET_ONE(zephyr_cdc_acm_uart);
	if (!usb_uart) {
		LOG_ERR("CDC ACM device not found");
		return;
	}

	err = usb_enable(NULL);
	if (err != 0) {
		LOG_ERR("Failed to enable USB");
		return;
	}

	uart_irq_callback_set(usb_uart, interrupt_handler);

	/* Enable rx interrupts */
	uart_irq_rx_enable(usb_uart);


	/* Initialize the Bluetooth Subsystem */
	err = bt_enable(NULL);
	if (err) {
		printk("Bluetooth init failed (err %d)\n", err);
		return;
	}

	printk("Bluetooth initialized\n");

	sensor_conn_init();

	start_scan();

	do {
		struct adv_data *data;

		data = get_adv_data();

		if (data != NULL)
		{
			static char strbuf[32];
			static char adv_data_hex[MAX_ADV_SIZE * 2 + 1];
			static char buf[1024];

			bt_addr_to_str(&data->addr.a, strbuf, sizeof(strbuf));

			bin2hex(data->adv_data, data->adv_data_len, adv_data_hex, sizeof(adv_data_hex));

			snprintf(buf, sizeof(buf), "%s,%d,%d,%d,%d,%s\n", strbuf, data->addr.type, data->rssi, data->adv_type, data->adv_data_len, adv_data_hex);
			write_tx(buf);

			free_adv_data(data);
		}
	} while (1);
}
```

## src/conn.c
```c
#include <zephyr/types.h>
#include <stddef.h>
#include <string.h>
#include <sys/printk.h>
#include <sys/util.h>

#include <bluetooth/bluetooth.h>
#include <bluetooth/hci.h>
#include <bluetooth/conn.h>
#include <bluetooth/uuid.h>
#include <bluetooth/gatt.h>
#include <sys/byteorder.h>

#include <usb/usb_device.h>
#include <sys/ring_buffer.h>
#include <drivers/uart.h>
#include <logging/log.h>

#include <stdio.h>

#include "conn.h"

static struct bt_conn *default_conn;

enum DeviceTypes
{
    LYWSD03MMC,
};
static enum DeviceTypes current_device_type;

#if 0

static void start_discovery(uint8_t type);
static struct bt_gatt_discover_params discover_params;
static uint8_t current_discovery_type;

static uint8_t discover_func(struct bt_conn *conn,
			     const struct bt_gatt_attr *attr,
			     struct bt_gatt_discover_params *params)
{
	if (!attr) {
		printk("Discover complete\n");

        if (current_discovery_type == BT_GATT_DISCOVER_PRIMARY)
        {
            start_discovery(BT_GATT_DISCOVER_CHARACTERISTIC);
        }
        else if (current_discovery_type == BT_GATT_DISCOVER_CHARACTERISTIC)
        {
            start_discovery(BT_GATT_DISCOVER_DESCRIPTOR);
        }
        else
        {
            (void)memset(params, 0, sizeof(*params));
            bt_conn_disconnect(conn, BT_HCI_ERR_REMOTE_USER_TERM_CONN);
        }

		return BT_GATT_ITER_STOP;
	}

	if (bt_uuid_cmp(attr->uuid, BT_UUID_GATT_PRIMARY) == 0)
	{
		printk("Primary: ");
	}
	else if (bt_uuid_cmp(attr->uuid, BT_UUID_GATT_CHRC) == 0)
	{
		printk("Characteristic: ");
	}
	else if (bt_uuid_cmp(attr->uuid, BT_UUID_GATT_CCC) == 0)
	{
		printk("CCC: ");
	}
	
	printk("[ATTRIBUTE] handle %x\n", attr->handle);

	return BT_GATT_ITER_CONTINUE;
}

static void start_discovery(uint8_t type)
{
	discover_params.uuid = NULL, // &uuid.uuid;
	discover_params.func = discover_func;
	discover_params.start_handle = 0x0001;
	discover_params.end_handle = 0xffff;
	discover_params.type = type;

    current_discovery_type = type;

	int err = bt_gatt_discover(default_conn, &discover_params);
	if (err) {
		printk("Discover failed(err %d)\n", err);
		return;
	}
}
#endif

static uint8_t notify_func_lywsd03mmc(struct bt_conn *conn,
			   struct bt_gatt_subscribe_params *params,
			   const void *data, uint16_t length)
{
	if (!data) {
		printk("[UNSUBSCRIBED]\n");
		params->value_handle = 0U;
        disconnect(conn);
		return BT_GATT_ITER_CONTINUE;
	}

    printk("Notified, length = %d\n", length);

    const uint8_t *d = data;
    for (int i = 0; i < length; i++)
    {
        printk("%d = %x\n", i, d[i]);
    }


    int16_t t = d[0] | (d[1] << 8);
    uint16_t humidity = d[2];
    uint16_t voltage = d[3] | (d[4] << 8);

    char addr[BT_ADDR_LE_STR_LEN];
    char buffer[64];

    bt_addr_to_str(&(bt_conn_get_dst(conn)->a), addr, sizeof(addr));

    printk("Temperature: %d, humidity %u, battery voltage %u\n", t, humidity, voltage);

    snprintf(buffer, sizeof(buffer), "%s,lywsd03mmc,%d,%u,%u\n", addr, t, humidity, voltage);
    write_tx(buffer);

    bt_gatt_unsubscribe(conn, params);

    disconnect(conn);

	return BT_GATT_ITER_STOP;
}

static void write_func_lywsd03mmc(struct bt_conn *conn, uint8_t err,
				     struct bt_gatt_write_params *params)
{
    printk("CMD written! err=%d\n", err);

    if (err)
    {
        disconnect(conn);
    }
}

void connected(struct bt_conn *conn, uint8_t err)
{
	char addr[BT_ADDR_LE_STR_LEN];

	bt_addr_le_to_str(bt_conn_get_dst(conn), addr, sizeof(addr));

	if (err) {
		printk("Failed to connect to %s (%d)\n", addr, err);

		bt_conn_unref(default_conn);
		default_conn = NULL;

		start_scan();
		return;
	}

	printk("Connected: %s\n", addr);

    // start_discovery(BT_GATT_DISCOVER_PRIMARY);
    // start_discovery(BT_GATT_DISCOVER_ATTRIBUTE);

    if (current_device_type == LYWSD03MMC)
    {
        static uint8_t data[3] = {
            0xf4, 0x01, 0x00,
        };

        static struct bt_gatt_write_params write_params = {
            .data = data,
            .length = sizeof(data),
            .handle = 0x0046,
            .func = write_func_lywsd03mmc,
        };
        err = bt_gatt_write(conn, &write_params);
        if (err) {
            printk("bt_gatt_write failed %d", err);
            disconnect(conn);
        }

        static struct bt_gatt_subscribe_params sub_params = {
            .notify = notify_func_lywsd03mmc,
            .value = BT_GATT_CCC_INDICATE,
            .value_handle = 0x0036,
            .ccc_handle = 0x0038,
        };

        err = bt_gatt_subscribe(conn, &sub_params);
        if (err && err != -EALREADY) {
            printk("Subscribe failed (err %d)\n", err);
            disconnect(conn);
        } else {
            printk("[SUBSCRIBED]\n");
        }
    }
}

void disconnect(struct bt_conn *conn)
{
    bt_conn_disconnect(conn, BT_HCI_ERR_REMOTE_USER_TERM_CONN);
}

void disconnected(struct bt_conn *conn, uint8_t reason)
{
	char addr[BT_ADDR_LE_STR_LEN];

	if (conn != default_conn) {
		return;
	}

	bt_addr_le_to_str(bt_conn_get_dst(conn), addr, sizeof(addr));

	printk("Disconnected: %s (reason 0x%02x)\n", addr, reason);

	bt_conn_unref(default_conn);
	default_conn = NULL;

	start_scan();
}

void handle_command(const char *cmd, const char *arg)
{
	if (strcmp(cmd, "LYWSD03MMC") == 0)
	{
		bt_addr_le_t addr;
		bt_addr_from_str(arg, &addr.a);
		addr.type = BT_ADDR_LE_PUBLIC;

		stop_scan();

		struct bt_conn_le_create_param create_param = {
			.options = BT_CONN_LE_OPT_NONE,
			.interval = BT_GAP_SCAN_FAST_INTERVAL,
			.window = BT_GAP_SCAN_FAST_INTERVAL,
			.timeout = 1000, // 10s
		};

		struct bt_le_conn_param conn_param = {
			.interval_min = BT_GAP_INIT_CONN_INT_MIN,
			.interval_max = BT_GAP_INIT_CONN_INT_MAX,
			.latency = 0,
			.timeout = 400,
		};

        current_device_type = LYWSD03MMC;

		int err = bt_conn_le_create(&addr, &create_param,
				&conn_param, &default_conn);

		if (err) {
			printk("Create conn to %s failed (%d)\n", arg, err);
			start_scan();
            return;
		}

	}
}
```

## src/sensor_conn.c
```c
#include <zephyr/types.h>
#include <stddef.h>
#include <string.h>
#include <zephyr/sys/printk.h>
#include <zephyr/sys/util.h>

#include <zephyr/bluetooth/bluetooth.h>
#include <zephyr/bluetooth/hci.h>
#include <zephyr/bluetooth/conn.h>
#include <zephyr/bluetooth/uuid.h>
#include <zephyr/bluetooth/gatt.h>
#include <zephyr/sys/byteorder.h>

#include <zephyr/usb/usb_device.h>
#include <zephyr/sys/ring_buffer.h>
#include <zephyr/drivers/uart.h>
#include <zephyr/logging/log.h>

#include <stdio.h>

#include "sensor_conn.h"
#include "sensor_scan.h"

static struct bt_conn *default_conn;

enum DeviceTypes
{
    LYWSD03MMC,
};
static enum DeviceTypes current_device_type;

#if 0

static void start_discovery(uint8_t type);
static struct bt_gatt_discover_params discover_params;
static uint8_t current_discovery_type;

static uint8_t discover_func(struct bt_conn *conn,
			     const struct bt_gatt_attr *attr,
			     struct bt_gatt_discover_params *params)
{
	if (!attr) {
		printk("Discover complete\n");

        if (current_discovery_type == BT_GATT_DISCOVER_PRIMARY)
        {
            start_discovery(BT_GATT_DISCOVER_CHARACTERISTIC);
        }
        else if (current_discovery_type == BT_GATT_DISCOVER_CHARACTERISTIC)
        {
            start_discovery(BT_GATT_DISCOVER_DESCRIPTOR);
        }
        else
        {
            (void)memset(params, 0, sizeof(*params));
            bt_conn_disconnect(conn, BT_HCI_ERR_REMOTE_USER_TERM_CONN);
        }

		return BT_GATT_ITER_STOP;
	}

	if (bt_uuid_cmp(attr->uuid, BT_UUID_GATT_PRIMARY) == 0)
	{
		printk("Primary: ");
	}
	else if (bt_uuid_cmp(attr->uuid, BT_UUID_GATT_CHRC) == 0)
	{
		printk("Characteristic: ");
	}
	else if (bt_uuid_cmp(attr->uuid, BT_UUID_GATT_CCC) == 0)
	{
		printk("CCC: ");
	}
	
	printk("[ATTRIBUTE] handle %x\n", attr->handle);

	return BT_GATT_ITER_CONTINUE;
}

static void start_discovery(uint8_t type)
{
	discover_params.uuid = NULL, // &uuid.uuid;
	discover_params.func = discover_func;
	discover_params.start_handle = 0x0001;
	discover_params.end_handle = 0xffff;
	discover_params.type = type;

    current_discovery_type = type;

	int err = bt_gatt_discover(default_conn, &discover_params);
	if (err) {
		printk("Discover failed(err %d)\n", err);
		return;
	}
}
#endif

static uint8_t notify_func_lywsd03mmc(struct bt_conn *conn,
			   struct bt_gatt_subscribe_params *params,
			   const void *data, uint16_t length)
{
	if (!data) {
		printk("[UNSUBSCRIBED]\n");
		params->value_handle = 0U;
        disconnect(conn);
		return BT_GATT_ITER_CONTINUE;
	}

    printk("Notified, length = %d\n", length);

    const uint8_t *d = data;
    for (int i = 0; i < length; i++)
    {
        printk("%d = %x\n", i, d[i]);
    }


    int16_t t = d[0] | (d[1] << 8);
    uint16_t humidity = d[2];
    uint16_t voltage = d[3] | (d[4] << 8);

    char addr[BT_ADDR_LE_STR_LEN];
    char buffer[64];

    bt_addr_to_str(&(bt_conn_get_dst(conn)->a), addr, sizeof(addr));

    printk("Temperature: %d, humidity %u, battery voltage %u\n", t, humidity, voltage);

    snprintf(buffer, sizeof(buffer), "%s,lywsd03mmc,%d,%u,%u\n", addr, t, humidity, voltage);
    write_tx(buffer);

    bt_gatt_unsubscribe(conn, params);

    disconnect(conn);

	return BT_GATT_ITER_STOP;
}

static void write_func_lywsd03mmc(struct bt_conn *conn, uint8_t err,
				     struct bt_gatt_write_params *params)
{
    printk("CMD written! err=%d\n", err);

    if (err)
    {
        disconnect(conn);
    }
}

static void on_connected(struct bt_conn *conn, uint8_t err)
{
	char addr[BT_ADDR_LE_STR_LEN];

	bt_addr_le_to_str(bt_conn_get_dst(conn), addr, sizeof(addr));

	if (err) {
		printk("Failed to connect to %s (%d)\n", addr, err);

		bt_conn_unref(default_conn);
		default_conn = NULL;

		start_scan();
		return;
	}

	printk("Connected: %s\n", addr);

    // start_discovery(BT_GATT_DISCOVER_PRIMARY);
    // start_discovery(BT_GATT_DISCOVER_ATTRIBUTE);

    if (current_device_type == LYWSD03MMC)
    {
        static uint8_t data[3] = {
            0xf4, 0x01, 0x00,
        };

        static struct bt_gatt_write_params write_params = {
            .data = data,
            .length = sizeof(data),
            .handle = 0x0046,
            .func = write_func_lywsd03mmc,
        };
        err = bt_gatt_write(conn, &write_params);
        if (err) {
            printk("bt_gatt_write failed %d", err);
            disconnect(conn);
        }

        static struct bt_gatt_subscribe_params sub_params = {
            .notify = notify_func_lywsd03mmc,
            .value = BT_GATT_CCC_INDICATE,
            .value_handle = 0x0036,
            .ccc_handle = 0x0038,
        };

        err = bt_gatt_subscribe(conn, &sub_params);
        if (err && err != -EALREADY) {
            printk("Subscribe failed (err %d)\n", err);
            disconnect(conn);
        } else {
            printk("[SUBSCRIBED]\n");
        }
    }
}

static void on_disconnected(struct bt_conn *conn, uint8_t reason)
{
	char addr[BT_ADDR_LE_STR_LEN];

	if (conn != default_conn) {
		return;
	}

	bt_addr_le_to_str(bt_conn_get_dst(conn), addr, sizeof(addr));

	printk("Disconnected: %s (reason 0x%02x)\n", addr, reason);

	bt_conn_unref(default_conn);
	default_conn = NULL;

	start_scan();
}

void disconnect(struct bt_conn *conn)
{
    bt_conn_disconnect(conn, BT_HCI_ERR_REMOTE_USER_TERM_CONN);
}

void handle_command(const char *cmd, const char *arg)
{
	if (strcmp(cmd, "LYWSD03MMC") == 0)
	{
		bt_addr_le_t addr;
		bt_addr_from_str(arg, &addr.a);
		addr.type = BT_ADDR_LE_PUBLIC;

		stop_scan();

		struct bt_conn_le_create_param create_param = {
			.options = BT_CONN_LE_OPT_NONE,
			.interval = BT_GAP_SCAN_FAST_INTERVAL,
			.window = BT_GAP_SCAN_FAST_INTERVAL,
			.timeout = 1000, // 10s
		};

		struct bt_le_conn_param conn_param = {
			.interval_min = BT_GAP_INIT_CONN_INT_MIN,
			.interval_max = BT_GAP_INIT_CONN_INT_MAX,
			.latency = 0,
			.timeout = 400,
		};

        current_device_type = LYWSD03MMC;

		int err = bt_conn_le_create(&addr, &create_param,
				&conn_param, &default_conn);

		if (err) {
			printk("Create conn to %s failed (%d)\n", arg, err);
			start_scan();
            return;
		}
	}
}

static struct bt_conn_cb conn_callbacks = {
		.connected = on_connected,
		.disconnected = on_disconnected,
};

void sensor_conn_init()
{
	bt_conn_cb_register(&conn_callbacks);
}
```

## src/sensor_conn.h
```c
#pragma once

void disconnect(struct bt_conn *conn);

void handle_command(const char *cmd, const char *arg);
void write_tx(const char *s);

void sensor_conn_init();
```

## src/sensor_scan.c
```c
#include <zephyr/types.h>
#include <stddef.h>
#include <string.h>
#include <zephyr/sys/printk.h>
#include <zephyr/sys/util.h>

#include <zephyr/bluetooth/bluetooth.h>
#include <zephyr/bluetooth/hci.h>

#include "sensor_scan.h"

K_MEM_SLAB_DEFINE(adv_data_slab, sizeof(struct adv_data), 64, 4);
K_FIFO_DEFINE(adv_data_fifo);

static void scan_cb(const bt_addr_le_t *addr, int8_t rssi, uint8_t adv_type,
		    struct net_buf_simple *buf)
{
	struct adv_data *data;

	if (k_mem_slab_alloc(&adv_data_slab, (void**) &data, K_NO_WAIT) == 0)
	{
		data->addr = *addr;
		data->rssi = rssi;
		data->adv_type = adv_type;
		data->adv_data_len = MIN(buf->len, sizeof(data->adv_data));
		memcpy(data->adv_data, buf->data, data->adv_data_len);

		k_fifo_put(&adv_data_fifo, data);
	}
	else
	{
		//printk("Could not allocate fifo item!\r\n");
	}
}

void start_scan()
{
	struct bt_le_scan_param scan_param = {
		.type       = BT_HCI_LE_SCAN_PASSIVE,
		.interval   = 0x0010,
		.window     = 0x0010,
	};

	int err = bt_le_scan_start(&scan_param, scan_cb);
	if (err) {
		printk("Starting scanning failed (err %d)\n", err);
		return;
	}
}

void stop_scan()
{
	bt_le_scan_stop();
}

struct adv_data *get_adv_data()
{
    return k_fifo_get(&adv_data_fifo, K_FOREVER);
}

void free_adv_data(struct adv_data *adv)
{
    k_mem_slab_free(&adv_data_slab, (void**) &adv);
}
```

## src/sensor_scan.h
```c
#pragma once

#include <stdint.h>

#define MAX_ADV_SIZE	(32)

struct adv_data
{
	// Fifo pointer, used by K_FIFO
	void *fifo_ptr;

	// Sender's address
	bt_addr_le_t addr;
	int8_t rssi;
	// Type of advertisement
	uint8_t adv_type;
	// Advertisement data length
	uint8_t adv_data_len;
	// Advertisement data
	uint8_t adv_data[MAX_ADV_SIZE];
};

void start_scan();
void stop_scan();

struct adv_data *get_adv_data();
void free_adv_data(struct adv_data *adv);
```
